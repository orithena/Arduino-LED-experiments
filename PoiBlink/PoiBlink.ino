#include "FastLED.h"

// How many leds in your strip?
#define NUM_LEDS 16
// Where is the LED data line connected?
#define DATA_PIN 2

// Define the array of leds
CRGB leds[NUM_LEDS];

#define MODE_COUNT 5

void setup() { 
  // Initialize the LEDs
  pinMode(DATA_PIN, OUTPUT); 
  FastLED.addLeds<APA106, DATA_PIN, RGB>(leds, NUM_LEDS);
  FastLED.setBrightness(255);
}

void loop() {
  uint32_t ms = millis();
  int s = ms >> 10;
  int mode = (s >> 5) % MODE_COUNT;
  switch(mode) {
    case 0:
      loop_Text(ms);
      break;
    case 1:
      loop_Rainbow(ms);
      break;
    case 2:
      loop_Rainbow_Inc(ms);
      break;
    case 3:
      loop_RGBBlink(ms);
      break;
    case 4:
      loop_Rainbow2(ms);
      break;
    case 5:
      loop_RGB_sawtooth(ms);
      break;
  }
  delay(10);
}

void Clear() {
  for( int i = 0; i < NUM_LEDS; i++) {
    leds[i] = CHSV(0,0,0);
  }
}

void loop_RGBBlink(uint32_t ms) { 
  int col = (ms >> 1);
  for( int i = 0; i < NUM_LEDS; i++ ) {
    
    leds[i] = CHSV(col,255,255 * ((ms >> 6) % 2));

  }
  
  FastLED.show();
}

void loop_WhiteBlink(uint32_t ms) { 
  for( int i = 0; i < NUM_LEDS; i++ ) {
    
    leds[i] = CHSV(60,0,160 * ((ms >> 6) % 2));

  }
  
  FastLED.show();
}

void loop_Rainbow2(uint32_t ms) { 
  Clear();
  int col = (ms);
  for( int i = 0; i < NUM_LEDS/2; i++ ) {
    
    leds[i << 1] = CHSV(col + i*(256/NUM_LEDS),255,255);
    leds[(i << 1)+1] = CHSV(col + (NUM_LEDS - i)*(256/NUM_LEDS),255,255);

  }
  
  FastLED.show();
}

void loop_Rainbow(uint32_t ms) { 
  Clear();
  int col = (ms >> 1);
  for( int i = 0; i < NUM_LEDS/2; i++ ) {
    
    leds[i] = CHSV(col + i*(128/NUM_LEDS),255,255);
    leds[NUM_LEDS - 1 - i] = CHSV(col + i*(128/NUM_LEDS),255,255);

  }
  
  FastLED.show();
}

void loop_Rainbow_Inc(uint32_t ms) { 
  Clear();
  int col = (ms >> 8) % NUM_LEDS;
  for( int i = 0; i <= col; i++ ) {
    
    leds[i] = CHSV(col + i*(255/NUM_LEDS),255,255);

  }
  
  FastLED.show();
}

void loop_RGB_sawtooth(uint32_t ms) { 
  Clear();
  int count = (ms >> 3) % (NUM_LEDS/2);
  int col = ((ms >> 3) / (NUM_LEDS/2)) % 3;
  for( int i = 0; i <= count; i++ ) {
    
    leds[i] = CHSV(col*85,255,255);
    leds[NUM_LEDS - 1 - i] = CHSV(col*85,255,255);

  }
  
  FastLED.show();
}

static unsigned char Font5x7[] = {
  0x00, 0x00, 0x00, 0x00, 0x00,// (space)
  0x00, 0x00, 0x5F, 0x00, 0x00,// !
  0x00, 0x07, 0x00, 0x07, 0x00,// "
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  0x08, 0x1C, 0x2A, 0x08, 0x08 // <-
};

unsigned char* Char(unsigned char* font, char c) {
  return &font[(c - 32) * 5];
}

void DrawSprite(unsigned char* sprite, int xOffset) {
  if( xOffset > 4 ) { return; }
  for ( byte y = 0; y < 7; y++) {
      bool on = (sprite[xOffset] >> (6 - y) & 1);
      if (on) {
        leds[ (NUM_LEDS/2) - 1 - y ]  = CHSV( 170, 255, 255 );
        leds[ (NUM_LEDS/2) + y ]  = CHSV( 170, 255, 255 );
      }
  }
}

void DrawText(char *text, int x) {
  DrawSprite(Char(Font5x7, text[x/6]), x%6);
}

uint32_t textcounter = 0;
void loop_Text(uint32_t ms) {
  Clear();
  DrawText("HALLO!", textcounter % 36);
  FastLED.show();
  textcounter++;
}
